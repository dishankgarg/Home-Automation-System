 
#include <LiquidCrystal_I2C.h>            //import the LiquidCrystal_I2C library
#include <ESP8266WiFi.h>                  //SP8266WiFi library allows you to connect an ESP8266-based microcontroller to a Wi-Fi network, and perform tasks such as connecting to an access point, obtaining an IP address, configuring Wi-Fi settings, and sending/receiving data over the Wi-Fi network
#include <Servo.h>                        // import servo.h library to provide functions for controlling servo motors
#include <Wire.h>                         // import wire.h library which provides functions for communicating with I2C (Inter-Integrated Circuit) devices.
#define LCD_ADDRESS 0x27                  // used to define the I2C address of the LCD display as "0x27"

#define LCD_ROWS D1                       // Define LCD row on D1
#define LCD_COLUMNS D2                    // Define LCD column on D2


const char* ssid = "Devesh";            //Wifi Name
const char* password = "hsxs1253";       //wifi password



int output_lm35= A0;                        // initializes  the output pin of the LM35 temperature sensor



WiFiServer server(80);                    // Create an instance of the server


Servo myservo;                            //initiate a servo motor name "myservo" 


const int servoPin = D4;                 // Define pin  D4 for servo motor


LiquidCrystal_I2C lcd(LCD_ADDRESS, LCD_COLUMNS, LCD_ROWS);      // Create LiquidCrystal_I2C object
 

void setup() {
  Serial.begin(115200);   //
  Wire.begin();           //
  pinMode(D5,OUTPUT);     //  define D5 pin for output Green led
  pinMode(D6,OUTPUT);     //  define D6 pin for output red led
  pinMode(D0,OUTPUT);     //Define pin D0 as output pin for Buzzer
  
  lcd.init();             // Initialize LCD
  lcd.backlight();        //turn on backlight of the LCD
  delay(10);              

  
  WiFi.begin(ssid, password);            // Connect to Wi-Fi
  while (WiFi.status() != WL_CONNECTED)  //wait untill the nodemcu is connected to the wifi
  {
    delay(1000);
    Serial.println("Connecting to WiFi..."); //print connecting to wifi after 1000ms till it connects
  }

  Serial.println("Connected to WiFi");       
  Serial.print("Local IP address: ");
  Serial.println(WiFi.localIP());             //prints the IP address generated by the nodemcu

  
  myservo.attach(servoPin);                   //// Attach servo motor to the pin D4
 
  
  server.begin();                              //// Start the server
  Serial.println("Server started");
  myservo.write(180);
  
}



void loop() {

  //temperature 
  int analogValue = analogRead(output_lm35);
  float millivolts = (analogValue/1024.0) * 3300; //3300mv is the voltage provided by NodeMCU
  float celcius = millivolts/10;
  if(celcius>=50)                                 //if the temperature >=50, the buzzer will be ON
    {
      digitalWrite(D0,HIGH);
    }

    if(celcius<50)                                //when the temperature <50, the buzzer will be turned OFF
    {
      digitalWrite(D0,LOW);
      }
 
  lcd.setCursor(0, 1);                            //Set the LCD cursor (0,1)
  lcd.print(String("Temp :")+ String(celcius));   //print "temp : " celcius 
  
  WiFiClient client = server.available();         // Check for incoming client connections
  if (client) 
  {
    Serial.println("New client connected");

    // Read the client's request
    String request = client.readStringUntil('\r');
    Serial.println(request);
    client.flush();

    // Send a response header
    client.println("HTTP/1.1 200 OK");
    client.println("Content-type:text/html");
    client.println();

    // Send the HTML page
    client.println("<html>");
    client.println("<center>");
    //client.println("<img src='https://www.google.com/url?sa=i&url=https%3A%2F%2Fnirmauni.ac.in%2F&psig=AOvVaw0nDCH_uBe4wvlXaeCLR_cm&ust=1681126086259000&source=images&cd=vfe&ved=0CBEQjRxqFwoTCLi7sezYnP4CFQAAAAAdAAAAABAD' alt='nirma'>");
    //client.println("<head><title>Door Lock System</title></head>");
    client.println("<body>");
    //client.println("<h1>Door Lock System</h1>");
    //client.println("<h1><u><i>Embedded System Special Assignemnt</i></u></h1>");
    client.println("<h1>1.Dishank Garg</h1>");
    client.println("<h1>2.Devesh pareek</h1>");
    //client.println("<h3>Door</h3>");
    
    client.println("<form action=\"/unlock\" method=\"POST\">");
    //client.println("<input type=\"submit\" value=\"Unlock\">");
    client.println("</form>");

    client.println("<h3>Main Light </h3>");
    client.println("<form action=\"/lights_ON\" method=\"POST\">");
    client.println("<input type=\"submit\" value=\"ON\">");
    client.println("</form>");
    client.println("<form action=\"/lights_OFF\" method=\"POST\">");
    client.println("<input type=\"submit\" value=\"OFF\">");
    client.println("</form>");
    client.println("</body>");
    client.println("</center>");
    client.println("</html>");

    // Handle the request
     if (request.indexOf("/unlock") != -1) {
      // Unlock the door by rotating the servo to a different angle
      myservo.write(0);
        lcd.setCursor(0, 0);
        lcd.print("WELCOME!!!! ");
        lcd.setCursor(0, 1);
        lcd.print(String("Temp :")+ String(celcius));
        digitalWrite(D6,HIGH);
        digitalWrite(D5,LOW);
      delay(5000);
      myservo.write(180);
      digitalWrite(D6,LOW);
        digitalWrite(D5,HIGH);
      lcd.setCursor(0, 0);
        lcd.print("                 ");
        lcd.setCursor(0, 1);
        lcd.print(String("Temp :")+ String(celcius));
      client.println("<p>Door unlocked.</p>");
      delay(2000);
      digitalWrite(D5,LOW);
    }


     ///light ON
     if (request.indexOf("lights_ON") != -1) {
      // start Fan
      digitalWrite(D5,HIGH);
        lcd.setCursor(0, 0);
        lcd.print("Lights Started");
     
        client.println("<p>Light ON.</p>");
      delay(2000);
      lcd.setCursor(0, 0);
        lcd.print("                 ");
        lcd.setCursor(0, 1);
        lcd.print(String("Temp :")+ String(celcius));
      
      
    }

    //light OFF
    if (request.indexOf("/lights_OFF") != -1) {
      // OFF Fan
       digitalWrite(D5,LOW);
        lcd.setCursor(0, 0);
        lcd.print("Lights OFF       ");
        lcd.setCursor(0, 1);
        lcd.print(String("Temp :")+ String(celcius));
        
          client.println("<p>Lights OFF.</p>");
      delay(2000);
      lcd.setCursor(0, 0);
        lcd.print("               ");
        
        
    
    }

    
    // Close the client connection
    client.stop();
    Serial.println("Client disconnected");
  }
}
